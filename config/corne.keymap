/* source key position labels */
#include "zmk-helpers/key-labels/36.h"

/* map Zen's extra keys */
#define X_LH  &kp LGUI      // thumb row, left
#define X_RH  &smart_mouse  // thumb row, right

/* activate bluetooth */
#define CONFIG_WIRELESS

/* source the main keymap */
#include "base.keymap"

/* use 5-column layout for Zen */
/{ chosen { zmk,physical-layout = &kgoh_jian_5col_layout; }; };
